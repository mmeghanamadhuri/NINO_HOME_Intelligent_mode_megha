## main/Kconfig.projbuild
```kconfig
# Voice input is ES8311 Aux-in (Sirena AUX-out). Onboard MEMS is unused.
menu "NiNO audio"

    config NINO_ONBOARD_MIC_LOOPBACK
        bool
        default n
        help
            Unused. Onboard mic loopback is disabled; Aux-in is capture-only.

endmenu

menu "NiNO Eye Displays"

    choice NINO_EYE_DISPLAY
        prompt "Eye panel type"
        default NINO_EYE_DISPLAY_TFT

        config NINO_EYE_DISPLAY_OLED
            bool "SSD1351 OLED (Waveshare 1.27\" 128x96)"
            help
                Dual Waveshare SSD1351 RGB OLED modules. No backlight pin.
                Uses shadow framebuffer + delta SPI to reduce flicker.

        config NINO_EYE_DISPLAY_TFT
            bool "ST7735 TFT (1.44\" SPI 128x128)"
            help
                Dual 1.44 inch ST7735 SPI TFT modules (128x128 RGB565).
                Tie BL/LED to 3.3 V — GPIO 19 is SDIO CMD (Wi-Fi) on this board.
                Shared SPI: SCK 23, MOSI 22, DC 21, RST 6, CS 32/33.
                Battery ADC is GPIO 20; do not put TFT RST on GPIO 20.
    endchoice

    config NINO_ST7735_BL_HARDCODED_3V3
        bool "ST7735 backlight wired to 3.3 V (do not use GPIO 19)"
        depends on NINO_EYE_DISPLAY_TFT
        default y
        help
            GPIO 19 is SDIO CMD to the onboard ESP32-C6 (and USB D- on the
            Function EV Board). Tie TFT BL/LED to 3.3 V and enable this so
            st7735_init() never claims GPIO 19 (required for Wi-Fi/BLE).

endmenu
```

## sdkconfig.defaults.esp32p4
```kconfig
CONFIG_ESP32P4_SELECTS_REV_LESS_V3=y
CONFIG_ESP32P4_REV_MIN_0=y
CONFIG_RTC_CLK_SRC_EXT_CRYS=y
CONFIG_RTC_CLK_CAL_CYCLES=1024
CONFIG_SPIRAM_SPEED_200M=y
CONFIG_ESP_WIFI_REMOTE_ENABLED=y
CONFIG_SLAVE_IDF_TARGET_ESP32C6=y
CONFIG_ESP_HOSTED_CP_TARGET_ESP32C6=y
CONFIG_ESP_HOSTED_P4_DEV_BOARD_FUNC_BOARD=y
CONFIG_WIFI_RMT_STATIC_RX_BUFFER_NUM=8
CONFIG_WIFI_RMT_DYNAMIC_RX_BUFFER_NUM=32
# CONFIG_WIFI_RMT_STATIC_TX_BUFFER is not set
CONFIG_WIFI_RMT_DYNAMIC_TX_BUFFER=y
CONFIG_WIFI_RMT_DYNAMIC_TX_BUFFER_NUM=32
CONFIG_WIFI_RMT_AMPDU_TX_ENABLED=y
CONFIG_WIFI_RMT_TX_BA_WIN=32
CONFIG_WIFI_RMT_AMPDU_RX_ENABLED=y
CONFIG_WIFI_RMT_RX_BA_WIN=32
CONFIG_LWIP_TCP_SND_BUF_DEFAULT=65534
CONFIG_LWIP_TCP_WND_DEFAULT=65534
CONFIG_LWIP_TCP_RECVMBOX_SIZE=64
CONFIG_LWIP_UDP_RECVMBOX_SIZE=64
CONFIG_LWIP_TCPIP_RECVMBOX_SIZE=64
CONFIG_LWIP_TCP_SACK_OUT=y

# NimBLE host on P4, BLE controller on C6 via ESP-Hosted VHCI
CONFIG_BT_ENABLED=y
CONFIG_BT_CONTROLLER_DISABLED=y
CONFIG_BT_BLUEDROID_ENABLED=n
CONFIG_BT_NIMBLE_ENABLED=y
CONFIG_BT_NIMBLE_TRANSPORT_UART=n
CONFIG_ESP_WIFI_REMOTE_LIBRARY_HOSTED=y
CONFIG_ESP_HOSTED_ENABLE_BT_NIMBLE=y
CONFIG_ESP_HOSTED_NIMBLE_HCI_VHCI=y

# Keep internal DRAM for FreeRTOS/IDF; put NimBLE pools in PSRAM (fixes idle-task assert)
CONFIG_SPIRAM_MALLOC_RESERVE_INTERNAL=98304
CONFIG_SPIRAM_TRY_ALLOCATE_WIFI_LWIP=y
CONFIG_SPIRAM_ALLOW_STACK_EXTERNAL_MEMORY=y
CONFIG_BT_NIMBLE_MEM_ALLOC_MODE_EXTERNAL=y
CONFIG_BT_NIMBLE_HOST_TASK_STACK_SIZE=3072
CONFIG_BT_NIMBLE_ROLE_CENTRAL=n
CONFIG_BT_NIMBLE_ROLE_OBSERVER=n
CONFIG_BT_NIMBLE_GATT_CLIENT=n
CONFIG_BT_NIMBLE_MAX_CONNECTIONS=1
CONFIG_BT_NIMBLE_MSYS_1_BLOCK_COUNT=8
CONFIG_BT_NIMBLE_MSYS_2_BLOCK_COUNT=12
CONFIG_BT_NIMBLE_TRANSPORT_ACL_FROM_LL_COUNT=12
CONFIG_BT_NIMBLE_ATT_MAX_PREP_ENTRIES=16
CONFIG_BT_NIMBLE_PROX_SERVICE=n
CONFIG_BT_NIMBLE_ANS_SERVICE=n
CONFIG_BT_NIMBLE_CTS_SERVICE=n
CONFIG_BT_NIMBLE_HTP_SERVICE=n
CONFIG_BT_NIMBLE_IPSS_SERVICE=n
CONFIG_BT_NIMBLE_TPS_SERVICE=n
CONFIG_BT_NIMBLE_IAS_SERVICE=n
CONFIG_BT_NIMBLE_LLS_SERVICE=n
CONFIG_BT_NIMBLE_SPS_SERVICE=n
CONFIG_BT_NIMBLE_HR_SERVICE=n
CONFIG_BT_NIMBLE_BAS_SERVICE=n
CONFIG_BT_NIMBLE_DIS_SERVICE=n

# USB UVC ISOC transfers: prefer PSRAM so wake word + NimBLE do not exhaust internal DMA heap
CONFIG_USB_HOST_DWC_DMA_CAP_MEMORY_IN_PSRAM=y
```
